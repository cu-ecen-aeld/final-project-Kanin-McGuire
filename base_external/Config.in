## base_external/Config.in
```kconfig
source "$BR2_EXTERNAL_assignment_base_PATH/package/aesd-assignments/Config.in"
source "$BR2_EXTERNAL_assignment_base_PATH/package/bme280-driver/Config.in"
```

## base_external/package/bme280-driver/Config.in
```kconfig
config BR2_PACKAGE_BME280_DRIVER
	bool "bme280-driver"
	help
	  Includes the bme280-driver in the kernel image.
	  Used to understand buildroot external trees and package builds.
```
